## app/dts/bindings/behaviors/derui,japanese-input.yml
```yaml
# Copyright (c) 2020-2025 The ZMK Contributors
# SPDX-License-Identifier: MIT

description: Original japanese input behaviors

compatible: "derui,japanese-input"

include: one_param.yaml
```

## boards/shields/orbit_one/Kconfig.defconfig
```kconfig
# Copyright (c) 2021-2025 The ZMK Contributors
# SPDX-License-Identifier: MIT

if SHIELD_ORBIT_ONE_LEFT

# Name must be less than 16 characters long!
config ZMK_KEYBOARD_NAME
    default "Orbit One"

config ZMK_SPLIT_ROLE_CENTRAL
    default y

config I2C
    default y

config ZMK_POINTING
    default y

config ZMK_POINTING_SMOOTH_SCROLLING
    default y

endif

if SHILD_ORBET_ON_RIGHT
# Do not sleep to avoid connction issue
config ZMK_SLEEP
    default n
endif

if SHIELD_ORBIT_ONE_LEFT || SHIELD_ORBIT_ONE_RIGHT

config ZMK_SPLIT
    default y

config EC11
  default y

endif
```

## boards/shields/orbit_one/Kconfig.shield
```kconfig
# Copyright (c) 2021-2025 The ZMK Contributors
# SPDX-License-Identifier: MIT

# No whitespace after the comma or in your part name!
config SHIELD_ORBIT_ONE_LEFT
    def_bool $(shields_list_contains,orbit_one_left)

# No whitespace after the comma or in your part name!
config SHIELD_ORBIT_ONE_RIGHT
    def_bool $(shields_list_contains,orbit_one_right)
```

## boards/shields/planetes42/Kconfig.defconfig
```kconfig
# Copyright (c) 2021-2025 The ZMK Contributors
# SPDX-License-Identifier: MIT

if SHIELD_PLANETES42_LEFT

# Name must be less than 16 characters long!
config ZMK_KEYBOARD_NAME
    default "Planetes42"

config ZMK_SPLIT_ROLE_CENTRAL
    default y

config I2C
    default y

config ZMK_POINTING
    default y

endif

if SHILD_ORBET_ON_RIGHT
# Do not sleep to avoid connction issue
config ZMK_SLEEP
    default n
endif

if SHIELD_PLANETES42_LEFT || SHIELD_PLANETES42_RIGHT

config ZMK_SPLIT
    default y

config EC11
  default y

config ZMK_SPLIT_BLE
   default y

config PM_DEVICE
   default y

endif
```

## boards/shields/planetes42/Kconfig.shield
```kconfig
# Copyright (c) 2021-2025 The ZMK Contributors
# SPDX-License-Identifier: MIT

# No whitespace after the comma or in your part name!
config SHIELD_PLANETES42_LEFT
    def_bool $(shields_list_contains,planetes42_left)

# No whitespace after the comma or in your part name!
config SHIELD_PLANETES42_RIGHT
    def_bool $(shields_list_contains,planetes42_right)
```

## boards/shields/thingnus-ball/Kconfig.defconfig
```kconfig
# Copyright (c) 2021-2025 The ZMK Contributors
# SPDX-License-Identifier: MIT

if SHIELD_THINGNUS_BALL_RIGHT

# Name must be less than 16 characters long!
config ZMK_KEYBOARD_NAME
    default "ThingnusBall"

config ZMK_SPLIT_ROLE_CENTRAL
    default y

config INPUT
    bool
    default y

config PMW3610
    bool
    default y

config SPI
    bool
    default y

config ZMK_POINTING
    bool
    default y
endif

if SHILD_THINGNUS_BALL_LEFT
# Do not sleep to avoid connction issue
config ZMK_SLEEP
    default n

config EC11
  default y

endif

if SHIELD_THINGNUS_BALL_LEFT || SHIELD_THINGNUS_BALL_RIGHT

config ZMK_SPLIT
    default y

config ZMK_SPLIT_BLE
   default y

endif
```

## boards/shields/thingnus-ball/Kconfig.shield
```kconfig
# Copyright (c) 2021-2025 The ZMK Contributors
# SPDX-License-Identifier: MIT

# No whitespace after the comma or in your part name!
config SHIELD_THINGNUS_BALL_LEFT
    def_bool $(shields_list_contains,thingnus_ball_left)

# No whitespace after the comma or in your part name!
config SHIELD_THINGNUS_BALL_RIGHT
    def_bool $(shields_list_contains,thingnus_ball_right)
```
