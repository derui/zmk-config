/*
 * Copyright (c) 2020 The ZMK Contributors
 *
 * SPDX-License-Identifier: MIT
 */

#include <behaviors/japanese-input.dtsi>

/ {
    behaviors {
        jp: japanese_input {
            compatible = "derui,japanese-input";
            #binding-cells = <1>;
            display-name = "日本語のbinding";
        };
    };
};
